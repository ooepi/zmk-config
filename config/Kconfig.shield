## config/Kconfig.shield
```kconfig
# Copyright (c) 2020 Pete Johanson
# SPDX-License-Identifier: MIT

config SHIELD_GALIUM58_LEFT
    def_bool $(shields_list_contains,galium58_left)

config SHIELD_GALIUM58_RIGHT
    def_bool $(shields_list_contains,galium58_right)
```
